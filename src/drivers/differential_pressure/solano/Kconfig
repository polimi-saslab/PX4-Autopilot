## src/drivers/differential_pressure/solano/Kconfig
```kconfig
menuconfig DRIVERS_DIFFERENTIAL_PRESSURE_SOLANO
	bool "solano"
	default n
	---help---
		Raw 12-byte I2C reader for the Chronics Solano probe.
```

## src/drivers/wind_sensor/solano/Kconfig
```kconfig
menuconfig DRIVERS_WIND_SENSOR_SOLANO
	bool "solano"
	default n
	---help---
		I2C driver for the Chronics Solano airflow probe.
```
